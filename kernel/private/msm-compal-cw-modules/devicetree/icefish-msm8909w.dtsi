/* Copyright (c) 2015-2018, The Linux Foundation. All rights reserved.
 *
 * This program is free software; you can redistribute it and/or modify
 * it under the terms of the GNU General Public License version 2 and
 * only version 2 as published by the Free Software Foundation.
 *
 * This program is distributed in the hope that it will be useful,
 * but WITHOUT ANY WARRANTY; without even the implied warranty of
 * MERCHANTABILITY or FITNESS FOR A PARTICULAR PURPOSE.  See the
 * GNU General Public License for more details.
 */

#include "../compal-common/msm8909w.dtsi"

&mdss_dsi0 {
	qcom,dsi-pref-prim-pan = <&dsi_auo_u120blx_amoled_cmd>;

	qcom,platform-tsresout-gpio = <&msm_gpio 16 0>;
	qcom,platform-enable-gpio = <&msm_gpio 59 0>;
	qcom,platform-avdden-gpio = <&pm660_gpios 12 0>;
	/delete-property/ qcom,platform-bklight-en-gpio;
};
